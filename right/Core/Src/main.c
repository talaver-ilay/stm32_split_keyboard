/* USER CODE BEGIN Header */
/**
  ******************************************************************************
  * @file           : main.c
  * @brief          : Main program body
  ******************************************************************************
  * @attention
  *
  * Copyright (c) 2023 STMicroelectronics.
  * All rights reserved.
  *
  * This software is licensed under terms that can be found in the LICENSE file
  * in the root directory of this software component.
  * If no LICENSE file comes with this software, it is provided AS-IS.
  *
  ******************************************************************************
  */
/* USER CODE END Header */
/* Includes ------------------------------------------------------------------*/
#include "main.h"
#include "usb_device.h"

/* Private includes ----------------------------------------------------------*/
/* USER CODE BEGIN Includes */
#include <stdbool.h>
/* USER CODE END Includes */

/* Private typedef -----------------------------------------------------------*/
/* USER CODE BEGIN PTD */

/* USER CODE END PTD */

/* Private define ------------------------------------------------------------*/
/* USER CODE BEGIN PD */
/* USER CODE END PD */

/* Private macro -------------------------------------------------------------*/
/* USER CODE BEGIN PM */

/* USER CODE END PM */

/* Private variables ---------------------------------------------------------*/
I2C_HandleTypeDef hi2c1;
I2C_HandleTypeDef hi2c3;

/* USER CODE BEGIN PV */

/* USER CODE END PV */

/* Private function prototypes -----------------------------------------------*/
void SystemClock_Config(void);
static void MX_GPIO_Init(void);
static void MX_I2C1_Init(void);
static void MX_I2C3_Init(void);
/* USER CODE BEGIN PFP */
void ClearKey(void);
void FnKey(void);
void RowKey(uint8_t);
void delay_ms(uint16_t ms);
void TIM3_Encoder_init(void);
char str[] = "Hallo World!";
/* USER CODE END PFP */

/* Private user code ---------------------------------------------------------*/
/* USER CODE BEGIN 0 */

extern 			USBD_HandleTypeDef hUsbDeviceFS;

typedef struct{
	uint8_t ReportID;
	uint8_t MODIFIER;
	uint8_t RESERVED;
	uint8_t KEYCODE1;
	uint8_t KEYCODE2;
	uint8_t KEYCODE3;
	uint8_t KEYCODE4;
	uint8_t KEYCODE5;
	uint8_t KEYCODE6;
}keyboardHID;

union FnKey{
	uint16_t macros;
	uint8_t  KeyMacros[2];

}MacrosKey;



// 'frame_0_delay-0', 128x32px
const unsigned char epd_bitmap_frame_0_delay_0 []  = {
	0x00, 0x00, 0x00, 0x00, 0x00, 0x00, 0x00, 0x00, 0x00, 0x00, 0x00, 0x00, 0x00, 0x00, 0x00, 0x00, 
	0x00, 0x00, 0x00, 0x00, 0x00, 0x00, 0x00, 0x00, 0x00, 0x00, 0x00, 0x00, 0x00, 0x00, 0x00, 0x00, 
	0x00, 0x00, 0x00, 0x00, 0x00, 0x00, 0x00, 0x00, 0x00, 0x00, 0x00, 0x00, 0x00, 0x00, 0x00, 0x00, 
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	0x00, 0x00, 0x00, 0x00, 0x00, 0x00, 0x00, 0x00, 0x00, 0x30, 0x00, 0x00, 0x00, 0x00, 0x00, 0x00
};
// 'frame_1_delay-0', 128x32px
const unsigned char epd_bitmap_frame_1_delay_0 []  = {
	0x00, 0x00, 0x00, 0x00, 0x00, 0x00, 0x00, 0x00, 0x00, 0x00, 0x00, 0x84, 0x00, 0x00, 0x00, 0x00, 
	0x00, 0x00, 0x00, 0x00, 0x00, 0x00, 0x00, 0x00, 0x00, 0x00, 0x61, 0x8c, 0x00, 0x00, 0x00, 0x00, 
	0x00, 0x00, 0x00, 0x00, 0x00, 0x00, 0x00, 0x00, 0x00, 0x00, 0x79, 0x9c, 0x00, 0x00, 0x00, 0x00, 
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	0x00, 0x00, 0x00, 0x00, 0x00, 0x00, 0x00, 0x00, 0x00, 0x00, 0x00, 0x00, 0x00, 0x00, 0x00, 0x00
};
// 'frame_3_delay-0', 128x32px
const unsigned char epd_bitmap_frame_3_delay_0 []  = {
	0x00, 0x00, 0x00, 0x00, 0x00, 0x00, 0x00, 0x00, 0x00, 0x00, 0x00, 0x00, 0x00, 0x00, 0x00, 0x00, 
	0x00, 0x00, 0x00, 0x00, 0x00, 0x01, 0x86, 0x08, 0x00, 0x00, 0x00, 0x00, 0x00, 0x00, 0x00, 0x00, 
	0x00, 0x00, 0x00, 0x00, 0x00, 0x00, 0xc6, 0x38, 0x00, 0x00, 0x00, 0x00, 0x00, 0x00, 0x00, 0x00, 
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	0x00, 0x00, 0x00, 0x00, 0x00, 0x00, 0x00, 0x00, 0x00, 0x00, 0x00, 0x00, 0x00, 0x00, 0x00, 0x00
};
// 'frame_5_delay-0', 128x32px
const unsigned char epd_bitmap_frame_5_delay_0 []  = {
	0x00, 0x00, 0x00, 0x00, 0x00, 0x00, 0x00, 0x00, 0x00, 0x00, 0x00, 0x80, 0x00, 0x00, 0x00, 0x00, 
	0x00, 0x00, 0x00, 0x00, 0x00, 0x00, 0x06, 0x00, 0x00, 0x00, 0xe1, 0x8c, 0x00, 0x00, 0x00, 0x00, 
	0x00, 0x00, 0x00, 0x00, 0x00, 0x00, 0x0e, 0x08, 0x00, 0x00, 0x71, 0x9c, 0x00, 0x00, 0x00, 0x00, 
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	0x00, 0x00, 0x00, 0x00, 0x00, 0x00, 0x00, 0x00, 0x00, 0x00, 0x00, 0x00, 0x00, 0x00, 0x00, 0x00
};

// Array of all bitmaps for convenience. (Total bytes used to store images in  = 3168)
const int epd_bitmap_allArray_LEN = 6;
const unsigned char* epd_bitmap_allArray[epd_bitmap_allArray_LEN] = {
	epd_bitmap_frame_0_delay_0,
	epd_bitmap_frame_1_delay_0,
	epd_bitmap_frame_0_delay_0,
	epd_bitmap_frame_3_delay_0,
	epd_bitmap_frame_0_delay_0,
	epd_bitmap_frame_5_delay_0
};




keyboardHID keyboardhid = {1,0,0,0,0,0,0,0,0};
//keyboardHID consumerhid = {2,0};

const uint8_t KeyArray[4][6] ={		{key_y, key_u, key_i, key_o, key_p,key_SquareBrackets_Left},//
													  
																	{key_h, key_j, key_k, key_l, key_Semicolon, key_SquareBrackets_Right},
													  
																	{key_n,  key_m, key_Comma,  key_UpArrow, key_Dot, key_Apostrophe},
													  
																	{key_Fn, key_Spacebar, key_Enter , key_LeftArrow, key_DownArrow, key_RightArrow},};
		
const uint16_t KeyFn[4][6] ={			{Fn_y, Fn_u, Fn_i, Fn_o, Fn_p,Fn_SquareBrackets_Left},//
													  
																	{Fn_h, Fn_j, Fn_k, Fn_l, Fn_Semicolon, Fn_SquareBrackets_Right},
													  
																	{Fn_n,  Fn_m, Fn_Comma,  Fn_Up, Fn_Dot, Fn_Apostrophe},
													  
																	{key_Fn, 0, 0 , 0, 0, 0},};
			
const uint16_t FnNum[4][6] ={			{key_7, key_8, key_9, key_0, key_Equal, key_underscore},//
													  
																	{key_4, key_5, key_6, key_Minus, key_Slash, key_Backslash},
													  
																	{key_1,  key_2, key_3,  key_DELETE, key_Plus, key_cbar},
													  
																	{key_Fn, 0, 0, 0, 0, 0},};
			
																 
																 
//uint8_t EncoderNum = 0, PreviousEncoderNum= 0;		
																 
/* USER CODE END 0 */

/**
  * @brief  The application entry point.
  * @retval int
  */
int main(void)
{
  /* USER CODE BEGIN 1 */
	 
	
  /* USER CODE END 1 */

  /* MCU Configuration--------------------------------------------------------*/

  /* Reset of all peripherals, Initializes the Flash interface and the Systick. */
	HAL_Init();
		
  /* USER CODE BEGIN Init */

  /* USER CODE END Init */

  /* Configure the system clock */
  SystemClock_Config();

  /* USER CODE BEGIN SysInit */

  /* USER CODE END SysInit */

  /* Initialize all configured peripherals */
  MX_GPIO_Init();
  MX_USB_DEVICE_Init();
  MX_I2C1_Init();
  MX_I2C3_Init();
	ssd1306_Init();
  /* USER CODE BEGIN 2 */
	
	//void USB_Send(void);
	
	//TIM3_Encoder_init();
	ClearKey();
	uint8_t imageNum[2] = {0};
	
  /* USER CODE END 2 */
  /* Infinite loop */
  /* USER CODE BEGIN WHILE */
  while (1)
  {	
/////////////////////////Encoder////////////////////////////////////////////////
//		PreviousEncoderNum = EncoderNum;
//		EncoderNum = TIM3->CNT;
//		
//		if(EncoderNum>PreviousEncoderNum)consumerhid.MODIFIER = USB_HID_VOL_UP;
//		else if(EncoderNum<PreviousEncoderNum)consumerhid.MODIFIER = USB_HID_VOL_DEC;
//		
//		USBD_CUSTOM_HID_SendReport(&hUsbDeviceFS, &consumerhid, sizeof (consumerhid));			
//		consumerhid.MODIFIER = 0;
//		USBD_CUSTOM_HID_SendReport(&hUsbDeviceFS, &consumerhid, sizeof (consumerhid));
//		delay_ms(10);
		
/////////////////////////Keyboard///////////////////////////////////////////////
			for(int i = 0;i<4;i++) RowKey(i);
			FnKey();
			USBD_CUSTOM_HID_SendReport(&hUsbDeviceFS, &keyboardhid, sizeof (keyboardhid));
			ClearKey();
			USBD_CUSTOM_HID_SendReport(&hUsbDeviceFS, &keyboardhid, sizeof (keyboardhid));
			//delay_ms(100);
			
    /* USER CODE END WHILE */
		
		ssd1306_Fill(Black);
		ssd1306_DrawBitmap(0,0,epd_bitmap_allArray[imageNum[1]],128,32,White);
		ssd1306_UpdateScreen();
		imageNum[0]++;
		if(imageNum[0] == 5){
			imageNum[0] = 0;
			imageNum[1]++;
			if(imageNum[1] == epd_bitmap_allArray_LEN) imageNum[1] =0;
		}
	
	
    /* USER CODE BEGIN 3 */
  }
  /* USER CODE END 3 */
}

/**
  * @brief System Clock Configuration
  * @retval None
  */
void SystemClock_Config(void)
{
  RCC_OscInitTypeDef RCC_OscInitStruct = {0};
  RCC_ClkInitTypeDef RCC_ClkInitStruct = {0};

  /** Configure the main internal regulator output voltage
  */
  __HAL_RCC_PWR_CLK_ENABLE();
  __HAL_PWR_VOLTAGESCALING_CONFIG(PWR_REGULATOR_VOLTAGE_SCALE2);

  /** Initializes the RCC Oscillators according to the specified parameters
  * in the RCC_OscInitTypeDef structure.
  */
  RCC_OscInitStruct.OscillatorType = RCC_OSCILLATORTYPE_HSE;
  RCC_OscInitStruct.HSEState = RCC_HSE_ON;
  RCC_OscInitStruct.PLL.PLLState = RCC_PLL_ON;
  RCC_OscInitStruct.PLL.PLLSource = RCC_PLLSOURCE_HSE;
  RCC_OscInitStruct.PLL.PLLM = 25;
  RCC_OscInitStruct.PLL.PLLN = 336;
  RCC_OscInitStruct.PLL.PLLP = RCC_PLLP_DIV4;
  RCC_OscInitStruct.PLL.PLLQ = 7;
  if (HAL_RCC_OscConfig(&RCC_OscInitStruct) != HAL_OK)
  {
    Error_Handler();
  }

  /** Initializes the CPU, AHB and APB buses clocks
  */
  RCC_ClkInitStruct.ClockType = RCC_CLOCKTYPE_HCLK|RCC_CLOCKTYPE_SYSCLK
                              |RCC_CLOCKTYPE_PCLK1|RCC_CLOCKTYPE_PCLK2;
  RCC_ClkInitStruct.SYSCLKSource = RCC_SYSCLKSOURCE_PLLCLK;
  RCC_ClkInitStruct.AHBCLKDivider = RCC_SYSCLK_DIV1;
  RCC_ClkInitStruct.APB1CLKDivider = RCC_HCLK_DIV2;
  RCC_ClkInitStruct.APB2CLKDivider = RCC_HCLK_DIV1;

  if (HAL_RCC_ClockConfig(&RCC_ClkInitStruct, FLASH_LATENCY_2) != HAL_OK)
  {
    Error_Handler();
  }
}

/**
  * @brief I2C1 Initialization Function
  * @param None
  * @retval None
  */
static void MX_I2C1_Init(void)
{

  /* USER CODE BEGIN I2C1_Init 0 */

  /* USER CODE END I2C1_Init 0 */

  /* USER CODE BEGIN I2C1_Init 1 */

  /* USER CODE END I2C1_Init 1 */
  hi2c1.Instance = I2C1;
  hi2c1.Init.ClockSpeed = 100000;
  hi2c1.Init.DutyCycle = I2C_DUTYCYCLE_2;
  hi2c1.Init.OwnAddress1 = 0;
  hi2c1.Init.AddressingMode = I2C_ADDRESSINGMODE_7BIT;
  hi2c1.Init.DualAddressMode = I2C_DUALADDRESS_DISABLE;
  hi2c1.Init.OwnAddress2 = 0;
  hi2c1.Init.GeneralCallMode = I2C_GENERALCALL_DISABLE;
  hi2c1.Init.NoStretchMode = I2C_NOSTRETCH_DISABLE;
  if (HAL_I2C_Init(&hi2c1) != HAL_OK)
  {
    Error_Handler();
  }
  /* USER CODE BEGIN I2C1_Init 2 */

  /* USER CODE END I2C1_Init 2 */

}

/**
  * @brief I2C3 Initialization Function
  * @param None
  * @retval None
  */
static void MX_I2C3_Init(void)
{

  /* USER CODE BEGIN I2C3_Init 0 */

  /* USER CODE END I2C3_Init 0 */

  /* USER CODE BEGIN I2C3_Init 1 */

  /* USER CODE END I2C3_Init 1 */
  hi2c3.Instance = I2C3;
  hi2c3.Init.ClockSpeed = 100000;
  hi2c3.Init.DutyCycle = I2C_DUTYCYCLE_2;
  hi2c3.Init.OwnAddress1 = 0;
  hi2c3.Init.AddressingMode = I2C_ADDRESSINGMODE_7BIT;
  hi2c3.Init.DualAddressMode = I2C_DUALADDRESS_DISABLE;
  hi2c3.Init.OwnAddress2 = 0;
  hi2c3.Init.GeneralCallMode = I2C_GENERALCALL_DISABLE;
  hi2c3.Init.NoStretchMode = I2C_NOSTRETCH_DISABLE;
  if (HAL_I2C_Init(&hi2c3) != HAL_OK)
  {
    Error_Handler();
  }
  /* USER CODE BEGIN I2C3_Init 2 */

  /* USER CODE END I2C3_Init 2 */

}

/**
  * @brief GPIO Initialization Function
  * @param None
  * @retval None
  */
static void MX_GPIO_Init(void)
{
  GPIO_InitTypeDef GPIO_InitStruct = {0};

  /* GPIO Ports Clock Enable */
  __HAL_RCC_GPIOC_CLK_ENABLE();
  __HAL_RCC_GPIOH_CLK_ENABLE();
  __HAL_RCC_GPIOA_CLK_ENABLE();
  __HAL_RCC_GPIOB_CLK_ENABLE();

  /*Configure GPIO pin Output Level */
  HAL_GPIO_WritePin(GPIOC, GPIO_PIN_13, GPIO_PIN_SET);

  /*Configure GPIO pin Output Level */
  HAL_GPIO_WritePin(GPIOB, GPIO_PIN_0|GPIO_PIN_1|GPIO_PIN_3
														|GPIO_PIN_5|GPIO_PIN_8|GPIO_PIN_9, GPIO_PIN_SET);

  /*Configure GPIO pin : PC13 */
  GPIO_InitStruct.Pin  = GPIO_PIN_13;
  GPIO_InitStruct.Mode = GPIO_MODE_OUTPUT_PP;
  GPIO_InitStruct.Pull = GPIO_NOPULL;
  GPIO_InitStruct.Speed = GPIO_SPEED_FREQ_VERY_HIGH;
  HAL_GPIO_Init(GPIOC, &GPIO_InitStruct);

  /*Configure GPIO pins : PB0 PB1 PB2 PB3 PB5 PB8 */
  GPIO_InitStruct.Pin = GPIO_PIN_0|GPIO_PIN_1|GPIO_PIN_3|GPIO_PIN_5
											 |GPIO_PIN_8|GPIO_PIN_9;
  GPIO_InitStruct.Mode = GPIO_MODE_INPUT;
  GPIO_InitStruct.Pull = GPIO_PULLUP;
  HAL_GPIO_Init(GPIOB, &GPIO_InitStruct);
	GPIOB->BSRR = GPIO_BSRR_BS2;
  /*Configure GPIO pins : PA0 PA1 PA2 PA3*/
  GPIO_InitStruct.Pin   = GPIO_PIN_1 | GPIO_PIN_2|GPIO_PIN_3|GPIO_PIN_4;
  GPIO_InitStruct.Mode  = GPIO_MODE_OUTPUT_PP;
  GPIO_InitStruct.Pull  = GPIO_PULLUP;
  GPIO_InitStruct.Speed = GPIO_SPEED_FREQ_LOW;
  HAL_GPIO_Init(GPIOA, &GPIO_InitStruct);
	
}

/* USER CODE BEGIN 4 */

void ClearKey(void){ // отжать все кнопки
			keyboardhid.MODIFIER = 0;
			keyboardhid.KEYCODE1 = 0;
			keyboardhid.KEYCODE2 = 0;
			keyboardhid.KEYCODE3 = 0;
			keyboardhid.KEYCODE4 = 0;
			keyboardhid.KEYCODE5 = 0;
			keyboardhid.KEYCODE6 = 0;
}



void RowKey(uint8_t rowNum){
		if(rowNum == 0) GPIOA->BSRR = GPIO_BSRR_BR1;
		else if(rowNum == 1) GPIOA->BSRR = GPIO_BSRR_BR2;
		else if(rowNum == 2) GPIOA->BSRR = GPIO_BSRR_BR3;
		else if(rowNum == 3) GPIOA->BSRR = GPIO_BSRR_BR4;
		
		if(!(GPIOB->IDR & GPIO_IDR_IDR_0)){
			if		 (!keyboardhid.KEYCODE1) keyboardhid.KEYCODE1 = KeyArray[rowNum][0];
			else if(!keyboardhid.KEYCODE2) keyboardhid.KEYCODE2 = KeyArray[rowNum][0];
		}
		if(!(GPIOB->IDR & GPIO_IDR_IDR_1)){
			if		 (!keyboardhid.KEYCODE1) keyboardhid.KEYCODE1 = KeyArray[rowNum][1];
			else if(!keyboardhid.KEYCODE2) keyboardhid.KEYCODE2 = KeyArray[rowNum][1];
		}
		if(!(GPIOB->IDR & GPIO_IDR_IDR_3)){
			if		 (!keyboardhid.KEYCODE1) keyboardhid.KEYCODE1 = KeyArray[rowNum][2];
			else if(!keyboardhid.KEYCODE2) keyboardhid.KEYCODE2 = KeyArray[rowNum][2];
		}
		if(!(GPIOB->IDR & GPIO_IDR_IDR_5)){
			if		 (!keyboardhid.KEYCODE1) keyboardhid.KEYCODE1 = KeyArray[rowNum][3];
			else if(!keyboardhid.KEYCODE2) keyboardhid.KEYCODE2 = KeyArray[rowNum][3];
		}
		if(!(GPIOB->IDR & GPIO_IDR_IDR_8)){
			if		 (!keyboardhid.KEYCODE1) keyboardhid.KEYCODE1 = KeyArray[rowNum][4];
			else if(!keyboardhid.KEYCODE2) keyboardhid.KEYCODE2 = KeyArray[rowNum][4];
		}
		if(!(GPIOB->IDR & GPIO_IDR_IDR_9)){
			if		 (!keyboardhid.KEYCODE1) keyboardhid.KEYCODE1 = KeyArray[rowNum][5];
			else if(!keyboardhid.KEYCODE2) keyboardhid.KEYCODE2 = KeyArray[rowNum][5];
		}
		if(rowNum == 0) GPIOA->BSRR = GPIO_BSRR_BS1;
		else if(rowNum == 1) GPIOA->BSRR = GPIO_BSRR_BS2;
		else if(rowNum == 2) GPIOA->BSRR = GPIO_BSRR_BS3;
		else if(rowNum == 3) GPIOA->BSRR = GPIO_BSRR_BS4;
		
}
void FnKey(void){
			MacrosKey.KeyMacros[0] = keyboardhid.KEYCODE1;
			MacrosKey.KeyMacros[1] = keyboardhid.KEYCODE2;
			if((MacrosKey.KeyMacros[1] == key_Fn) || (MacrosKey.KeyMacros[0] == key_Fn) ){
				HAL_GPIO_WritePin(GPIOC, GPIO_PIN_13, GPIO_PIN_RESET);
				for(int i = 0;i<4;i++){
					for(int j = 0;j<6;j++){
						if(MacrosKey.macros == KeyFn[i][j]){
							MacrosKey.macros = FnNum[i][j];
							keyboardhid.KEYCODE1 = MacrosKey.KeyMacros[0];
							keyboardhid.KEYCODE2 = MacrosKey.KeyMacros[1];
							break;}
					}		
				}
			}else{
				HAL_GPIO_WritePin(GPIOC, GPIO_PIN_13, GPIO_PIN_SET);
			}
}

void delay_ms(uint16_t ms){
   RCC->APB2ENR |= RCC_APB2ENR_TIM11EN;                                         // Включаем тактирование таймера
	 ms=ms*10;
	 TIM11->PSC = 8400-1;                                                         // устанавливаем предделитель 84,000,000 / 8399 = 10,000  0,0001s
   TIM11->ARR = ms - 1;                                                         // устанавливаем значение переполнения таймера
	 TIM11->EGR |= TIM_EGR_UG;                                                    // Генерируем Событие обновления для записи данных в регистры PSC и ARR
   TIM11->CR1 |= TIM_CR1_CEN|TIM_CR1_OPM;                                       // Запускаем таймер записью бита CEN и устанавливаем режим Одного прохода установкой бита OPM
	 while (TIM11->CR1 & TIM_CR1_CEN);                                            // Ждем окончания счета
}// END_delay_ms

void TIM3_Encoder_init(void){
	//разрешаем тактирование таймера TIM3
	RCC->APB1ENR |= RCC_APB1ENR_TIM3EN;

       //конфигурируем выводы к которым подключается энкодер как входы с подтяжкой к питанию
	GPIOA->MODER &= ~(GPIO_MODER_MODER6_0 | GPIO_MODER_MODER7_0);
	GPIOA->MODER |= (GPIO_MODER_MODER6_1 | GPIO_MODER_MODER7_1);
	GPIOA->PUPDR &= ~(GPIO_PUPDR_PUPDR6 | GPIO_PUPDR_PUPDR7);
	GPIOA->AFR[0] &= ~(GPIO_AFRL_AFSEL6 | GPIO_AFRL_AFSEL7); 
	GPIOA->AFR[0] |= (GPIO_AFRL_AFSEL6_1 | GPIO_AFRL_AFSEL7_1);	
	
         //настраиваем фильтр
  TIM3->CCMR1 |= TIM_CCMR1_IC1F | TIM_CCMR1_IC2F;
        //настраиваем мультиплексор
	TIM3->CCMR1 |= TIM_CCMR1_CC1S_0 | TIM_CCMR1_CC2S_0;
        //сигнал TIxFP1 появиться по возрастающему фронту
	TIM3->CCER &= ~(TIM_CCER_CC1P | TIM_CCER_CC2P);
        //счет по обоим фронтам 
	TIM3->SMCR |= TIM_SMCR_SMS_0 | TIM_SMCR_SMS_1;
         //максимальное значение счетчика 
	TIM3->ARR = 100;
        //включаем счетчик
	TIM3->CR1 |= TIM_CR1_CEN ;
	//обнуляем счетный регистр
	TIM3->CNT = 0;
}


/* USER CODE END 4 */

/**
  * @brief  This function is executed in case of error occurrence.
  * @retval None
  */
void Error_Handler(void)
{
  /* USER CODE BEGIN Error_Handler_Debug */
  /* User can add his own implementation to report the HAL error return state */
  __disable_irq();
  while (1)
  {
  }
  /* USER CODE END Error_Handler_Debug */
}

#ifdef  USE_FULL_ASSERT
/**
  * @brief  Reports the name of the source file and the source line number
  *         where the assert_param error has occurred.
  * @param  file: pointer to the source file name
  * @param  line: assert_param error line source number
  * @retval None
  */
void assert_failed(uint8_t *file, uint32_t line)
{
  /* USER CODE BEGIN 6 */
  /* User can add his own implementation to report the file name and line number,
     ex: printf("Wrong parameters value: file %s on line %d\r\n", file, line) */
  /* USER CODE END 6 */
}
#endif /* USE_FULL_ASSERT */
